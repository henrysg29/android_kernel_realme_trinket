## arch/arm64/realme/Kconfig
```kconfig
menu "Realme product selection"

config PRODUCT_REALME
	bool "Realme devices"
	help
	  This enables support for Realme devices.

config PRODUCT_REALME_SM6125
	bool "Realme SM6125 Common"
        select PRODUCT_REALME
        depends on ARCH_TRINKET

endmenu
```
